#include <M5EPD.h>
const uint8_t m_pozic[3200] PROGMEM =
{ 0x50,0x00,0x04,0x00, 0x04,0x00,0x01,0x06, 0x00,0x00,0x00,0x10, 0x00,0x00,0x00,0x01, 0x00,0x00,0x00,0x00, 0x00,0x00,0x00,0x91, 0x00,0x00,0x0b,0x09, 0xd0,0xc0,0x0c,0xe0,
  0x40,0x00,0x04,0x60, 0x11,0x00,0x01,0x01, 0x03,0x10,0x00,0x50, 0x00,0x03,0x00,0x00, 0x09,0x00,0x00,0x00, 0x90,0x90,0xb9,0x00, 0x00,0x0d,0xb0,0x99, 0xc0,0x00,0x0c,0xe0,
  0x40,0x00,0x04,0x60, 0x00,0x10,0x01,0x11, 0x00,0x00,0x02,0x00, 0x02,0x00,0x10,0x00, 0x01,0xa0,0x90,0x00, 0x19,0x59,0x00,0x00, 0x90,0x90,0x00,0x99, 0x0e,0xcb,0x00,0xdc,
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  0x40,0x00,0x04,0x60, 0x01,0x00,0x50,0x11, 0x00,0x20,0x00,0x30, 0x1a,0x31,0x10,0x00, 0xd0,0x00,0x29,0x00, 0x90,0x90,0x0a,0x09, 0x09,0x00,0xb9,0x90, 0x00,0xbc,0x0c,0xe0,
};
const uint8_t m_figur[1732] PROGMEM = // 198 272 298 274 398 292
{ 0x3c,0x3c,0x3c,0x3c,0x3c, 0x3c,0x3c,0x3c,0x3c,0x3c, 0x3c,0x3c,0x3c,0x3c,0x3c, 0x1a,0x49,0x19,0x19,0x4b,
  0x18,0x18,0x4d,0x17,0x17, 0x4f,0x16,0x16,0x46,0x85, 0x46,0x15,0x15,0x46,0x87, 0x46,0x14,0x14,0x46,0x89,
  0x46,0x13,0x13,0x46,0x8b, 0x46,0x12,0x13,0x45,0x8d, 0x45,0x12,0x13,0x45,0x8d, 0x45,0x12,0x13,0x44,0x8f,
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  0x0c,0x64,0x0c,0x0c,0x64, 0x0c,0x0d,0x62,0x0d,0x0e, 0x60,0x0e,
};
const uint16_t m_fig_u[6] PROGMEM = { 0,198,470,768,1042,1440 };
const uint16_t m_otv_u[101] PROGMEM = { 0,  3,  6, 13, 16, 27, 30, 33, 36, 39,
                                       44, 51, 56, 61, 68, 73, 78, 83, 86, 93,
                                       96,103,110,115,120,127,130,135,138,143,
                                      148,157,162,169,174,177,182,187,190,195,
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                                      418,425,428,431,434,439,444,447,450,453,
                                      456};
const uint16_t m_otvet[456] PROGMEM = {
      0xc241,0x51c1,0xd036,
      0xdcb3,0x579d,0xdce5,
      0xd54e,0x250e,0xa2d5,0x63c7,0x914e,0x61ce,0xc006,
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      0xb4ee,0x4bee,0xa913,
      };                        
uint8_t not_x = 1, not_y = 1, rb = 0, cod_col = 0, cod_cnt = 0, u_menu = 0 ;
uint8_t u_pozic = 0, col_fig = 6, col_fon = 1 ;
int smesh_d = 150, uk_mas = 0, uk_i = 0, uk_j = 0, uk_cnt = 0, m_poz_u =0 ; 
uint32_t Wbat1 = 0; 
long Lbat1 = 0;

M5EPD_Canvas canvas(&M5.EPD);
M5EPD_Canvas canvas1(&M5.EPD);
M5EPD_Canvas canvas2(&M5.EPD);

void Out_Figur(uint8_t kod_fig){
 if ((kod_fig&8)==8) {
  col_fig = 0;} else {
  col_fig = 7;}
 if((not_x + not_y)&1==1){
  col_fon = 1;} else {
  col_fon = 0;}
 if (kod_fig==0) {
  uk_mas = 0;
 } else {
  uk_mas = m_fig_u[(kod_fig&7)-1];
 }
 for (uk_j = 0; uk_j < 58; uk_j++){
  uk_i = 0;
  while ( uk_i < 60){
   rb = m_figur[uk_mas]; uk_mas++;
   cod_col = (rb&0xc0) >> 6; cod_cnt = (rb & 0x3f);
   for (uk_cnt = 0; uk_cnt < cod_cnt; uk_cnt++){
    if (cod_col == 0) { canvas1.drawPixel(uk_i, uk_j, col_fon); uk_i++; };
    if (cod_col == 1) { canvas1.drawPixel(uk_i, uk_j, 15 ); uk_i++; };
    if (cod_col == 2) { canvas1.drawPixel(uk_i, uk_j, col_fig); uk_i++; }
   }
  }
 }
}

void Out_Board() {
 canvas.fillCanvas(0);
 canvas.fillRect(  1, smesh_d  , 540,   5, 4);
 canvas.fillRect(  1, smesh_d+5,   2, 536, 4);
 canvas.fillRect(539, smesh_d+5,   2, 536, 4);
 for (int32_t j = 0; j < 4; j++){
  for (int32_t i = 0; i < 4; i++){
   canvas.fillRect( 3+i*134, smesh_d+5+j*134,    67, 67, 0);
   canvas.fillRect(70+i*134, smesh_d+5+j*134,    67, 67, 1);
   canvas.fillRect( 3+i*134, smesh_d+5+67+j*134, 67, 67, 1);
   canvas.fillRect(70+i*134, smesh_d+5+67+j*134, 67, 67, 0);
  }
 }
 canvas.fillRect(1, smesh_d+541, 540, 5, 4);
 canvas.pushCanvas(0,0,UPDATE_MODE_GC16);
 m_poz_u = u_pozic*32;
 for (int8_t i = 0; i < 32; i++){
  int8_t fig_r = (m_pozic[m_poz_u]&0xf0)>>4;   
  not_x = (i&0x03)<<1;     not_y = (i&0x3c)>>2; 
  not_y = 7-not_y;  
  int8_t fig_o = (fig_r&7);
  if ((fig_r&8)==0) {fig_o=fig_o+8;};
  if (fig_r!=0){Out_Figur(fig_o);
  canvas1.pushCanvas((not_x)*67+6, 159+not_y*67,UPDATE_MODE_GC16);};
  fig_r = (m_pozic[m_poz_u]&0x0f);
  not_x = ((i&0x03)<<1)+1; not_y = (i&0x3c)>>2;
  not_y = 7-not_y;  
  fig_o = (fig_r&7);
  if ((fig_r&8)==0) {fig_o=fig_o+8;};
  if (fig_r!=0){Out_Figur(fig_o);
  canvas1.pushCanvas((not_x)*67+6, 159+not_y*67,UPDATE_MODE_GC16);};
  m_poz_u++;
 }
}
void Out_Anime() {
 for (int32_t i_otv = m_otv_u[u_pozic]; i_otv < m_otv_u[u_pozic+1]; i_otv++){
  int8_t fig_r = (m_otvet[i_otv]&0xf000)>>12;
  not_x = (m_otvet[i_otv]&0x0e00)>>9;
  not_y = 7-((m_otvet[i_otv]&0x01c0)>>6);
  if((not_x + not_y)&1==1){col_fon = 1;} else {col_fon = 0;}
  Out_Figur(fig_r);   
  canvas1.pushCanvas(not_x*67+6, smesh_d+9+not_y*67,UPDATE_MODE_GC16);
  delay(1000);
  for (int32_t i = 0; i < 60; i++){
   for (int32_t j = 0; j < 58; j++){
    canvas1.drawPixel(i,j,col_fon);
   }
  }
  canvas1.pushCanvas(not_x*67+6, smesh_d+9+not_y*67,UPDATE_MODE_GC16);
  delay(600);
  not_x = (m_otvet[i_otv]&0x0038)>>3;
  not_y = 7-(m_otvet[i_otv]&0x0007);
  if((not_x + not_y)&1==1){col_fon = 1;} else {col_fon = 0;}
  Out_Figur(fig_r);   
  canvas1.pushCanvas(not_x*67+6, smesh_d+9+not_y*67,UPDATE_MODE_GC16);
  delay(1000);
  for (int32_t i = 0; i < 60; i++){
   for (int32_t j = 0; j < 58; j++){
    canvas1.drawPixel(i,j,col_fon);
   }
  }
  canvas1.pushCanvas(not_x*67+6, smesh_d+9+not_y*67,UPDATE_MODE_GC16);
  delay(600);
  Out_Figur(fig_r);   
  canvas1.pushCanvas(not_x*67+6, smesh_d+9+not_y*67,UPDATE_MODE_GC16);
  delay(1000);
 }
}
void setup(){
 M5.begin();
 M5.update();
 M5.EPD.SetRotation(90);
 M5.EPD.Clear(true);
 canvas.createCanvas(540, 960);
 canvas.fillCanvas(0);
 canvas1.createCanvas(60, 58);
 canvas1.fillCanvas(0);
 canvas2.createCanvas(440, 40);
 canvas2.fillCanvas(0);
 Wbat1 = M5.getBatteryVoltage();
 u_pozic = ((Wbat1>>1)&0x003f)+20;
 Out_Board();
 delay(500);
} 
void loop(){
 M5.update(); 
 if( M5.BtnL.wasPressed()) {
  if (u_menu == 0) {
   if (u_pozic != 0) {u_pozic--;}
   else {u_pozic=99;}
   Out_Board();
  } else {
   Out_Board();
   Wbat1 = M5.getBatteryVoltage();
   Lbat1 = Wbat1;
   canvas2.setTextSize(5);
   canvas2.drawNumber(Lbat1, 1, 1);
   canvas2.drawString("mV   sleep",130,1);
   canvas2.pushCanvas(50,780,UPDATE_MODE_GC16);
   delay(500);
   M5.shutdown(0);
  }
 }
 if( M5.BtnP.wasPressed()) {
  if (u_menu == 0) {
   u_menu = 1;
   Out_Anime();
  } else {
   u_menu = 0;
   Out_Board();
  }
 }
 if( M5.BtnR.wasPressed()) {
  u_menu = 0;
  if (u_pozic < 99) {u_pozic++;}
  else{u_pozic=0;}
  Out_Board();
 }
 delay(200);
}
