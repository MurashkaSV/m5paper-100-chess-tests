#include <M5EPD.h>
const uint8_t m_figur[1732] PROGMEM = // 198 272 298 274 398 292
{ 0x3c,0x3c,0x3c,0x3c,0x3c, 0x3c,0x3c,0x3c,0x3c,0x3c, 0x3c,0x3c,0x3c,0x3c,0x3c, 0x1a,0x49,0x19,0x19,0x4b,
  0x18,0x18,0x4d,0x17,0x17, 0x4f,0x16,0x16,0x46,0x85, 0x46,0x15,0x15,0x46,0x87, 0x46,0x14,0x14,0x46,0x89,
  0x46,0x13,0x13,0x46,0x8b, 0x46,0x12,0x13,0x45,0x8d, 0x45,0x12,0x13,0x45,0x8d, 0x45,0x12,0x13,0x44,0x8f,
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  0x0c,0x64,0x0c,0x0c,0x64, 0x0c,0x0d,0x62,0x0d,0x0e, 0x60,0x0e,
};
const uint16_t m_fig_u[6] PROGMEM = { 0,198,470,768,1042,1440 };
             
uint8_t not_x = 1, not_y = 1, rb = 0, cod_col = 0, cod_cnt = 0 ;
uint8_t col_fig = 7, col_fon = 1 ;
int smesh_d = 150, uk_mas = 0, uk_i = 0, uk_j = 0, uk_cnt = 0 ;  

M5EPD_Canvas canvas(&M5.EPD);
M5EPD_Canvas canvas1(&M5.EPD);

void Out_Figur(uint8_t kod_fig){
 if ((kod_fig&8)==8) {
  col_fig = 0;} else {
  col_fig = 7;}
 if((not_x + not_y)&1==1){
  col_fon = 1;} else {
  col_fon = 0;}
 if (kod_fig==0) {
  uk_mas = 0;
 } else {
  uk_mas = m_fig_u[(kod_fig&7)-1];
 }
 for (uk_j = 0; uk_j < 58; uk_j++){
  uk_i = 0;
  while ( uk_i < 60){
   rb = m_figur[uk_mas]; uk_mas++;
   cod_col = (rb&0xc0) >> 6; cod_cnt = (rb & 0x3f);
   for (uk_cnt = 0; uk_cnt < cod_cnt; uk_cnt++){
    if (cod_col == 0) { canvas1.drawPixel(uk_i, uk_j, col_fon); uk_i++; };
    if (cod_col == 1) { canvas1.drawPixel(uk_i, uk_j, 15 ); uk_i++; };
    if (cod_col == 2) { canvas1.drawPixel(uk_i, uk_j, col_fig); uk_i++; }
   }
  }
 }
}

void setup(){
 M5.begin();
 M5.update();
 M5.EPD.SetRotation(90);
 M5.EPD.Clear(true);
 canvas.createCanvas(540, 960);
 canvas.fillCanvas(0);
 canvas.pushCanvas(0,0,UPDATE_MODE_GC16);
 canvas1.createCanvas(60, 58);
 canvas1.fillCanvas(0);
 for (int8_t i = 0; i < 6; i++){
  int8_t fig_o = i+1;       // black pieces 1..6
  Out_Figur(fig_o);
  canvas1.pushCanvas((1+i)*67+6, 159+4*67,UPDATE_MODE_GC16);
  fig_o=fig_o+8;            // white pieces 1..6  
  Out_Figur(fig_o);
  canvas1.pushCanvas((1+i)*67+6, 159+3*67,UPDATE_MODE_GC16);
 }
} 
void loop(){
}
